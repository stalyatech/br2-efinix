## kernel_modules/stalya-fcu/Config.in
```kconfig
config BR2_PACKAGE_STALYA_FCU
	bool "ti375_oob FCU remoteproc driver and test firmware"
	depends on BR2_LINUX_KERNEL
	help
	  fcu_rproc.ko, which lets Linux load, start and stop the soft FCU
	  SoC through amp_ctrl, and fcu_fw_test.elf in /lib/firmware.
	  Built from the sw/ directory of the ti375_oob Efinity project;
	  the firmware needs a bare-metal RISC-V toolchain. tools/efx
	  enables this and fills in the paths (PROJECT_SW=fcu).

if BR2_PACKAGE_STALYA_FCU

config BR2_PACKAGE_STALYA_FCU_PROJECT
	string "Efinity project directory"

config BR2_PACKAGE_STALYA_FCU_BAREMETAL_BIN
	string "bare-metal RISC-V toolchain bin directory"

config BR2_PACKAGE_STALYA_FCU_BAREMETAL_PREFIX
	string "bare-metal RISC-V toolchain prefix"
	default "riscv-none-elf-"

endif
```

## kernel_modules/stalya-npu/Config.in
```kconfig
config BR2_PACKAGE_STALYA_NPU
	bool "StalyaNPU driver and tools"
	depends on BR2_LINUX_KERNEL
	depends on BR2_TOOLCHAIN_HAS_THREADS
	help
	  snpu.ko, libsnpu and snpu-bench for the StalyaNPU accelerator,
	  built from the sw/ directory of the stalyanpu IP. tools/efx
	  enables this and fills in the path (PROJECT_SW=npu).

if BR2_PACKAGE_STALYA_NPU

config BR2_PACKAGE_STALYA_NPU_SRCDIR
	string "stalyanpu sw/ directory"
	help
	  Absolute path of ip/stalyanpu/sw in the Efinity project.

endif
```

## package/asio/Config.in
```kconfig
comment "asio needs a toolchain w/ C++"
	depends on !BR2_INSTALL_LIBSTDCPP

config BR2_PACKAGE_ASIO
	bool "asio"
	depends on BR2_INSTALL_LIBSTDCPP
	help
	  Asio is a cross-platform C++ library for network and
	  low-level I/O programming.

	  https://github.com/chriskohlhoff/asio/
```

## package/fastcdr/Config.in
```kconfig
config BR2_PACKAGE_FASTCDR
	bool "fastcdr"
	depends on BR2_INSTALL_LIBSTDCPP
	help
	  eProsima Fast CDR is a C++ serialization library
	  implementing the CDR standard serialization mechanism.

	  https://github.com/eProsima/Fast-CDR
```

## package/fastdds/Config.in
```kconfig
comment "fastdds needs a toolchain w/ C++, threads"
	depends on !BR2_INSTALL_LIBSTDCPP || !BR2_TOOLCHAIN_HAS_THREADS

config BR2_PACKAGE_FASTDDS
	bool "fastdds"
	depends on BR2_INSTALL_LIBSTDCPP
	depends on BR2_TOOLCHAIN_HAS_THREADS
	select BR2_PACKAGE_ASIO
	select BR2_PACKAGE_FASTCDR
	select BR2_PACKAGE_FOONATHAN_MEMORY
	select BR2_PACKAGE_TINYXML2_V10
	help
	  eProsima Fast DDS is an implementation of the DDS standard.

	  https://github.com/eProsima/Fast-DDS
```

## package/foonathan-memory/Config.in
```kconfig
comment "foonathan-memory needs a toolchain w/ C++"
	depends on !BR2_INSTALL_LIBSTDCPP

config BR2_PACKAGE_FOONATHAN_MEMORY
	bool "foonathan-memory"
	depends on BR2_INSTALL_LIBSTDCPP
	help
	  foonathan::memory is an STL compatible C++ memory allocator
	  library.

	  https://github.com/foonathan/memory
```

## package/micro-xrce-dds-agent/Config.in
```kconfig
comment "micro-xrce-dds-agent needs a toolchain w/ C++, threads"
	depends on !BR2_INSTALL_LIBSTDCPP || !BR2_TOOLCHAIN_HAS_THREADS

config BR2_PACKAGE_MICRO_XRCE_DDS_AGENT
	bool "micro-xrce-dds-agent"
	depends on BR2_INSTALL_LIBSTDCPP
	depends on BR2_TOOLCHAIN_HAS_THREADS
	select BR2_PACKAGE_FASTCDR
	select BR2_PACKAGE_FASTDDS
	help
	  eProsima Micro XRCE-DDS Agent acts as a server between
	  DDS-XRCE Clients (e.g. PX4) and the DDS network,
	  supporting serial, UDP and TCP transports.

	  https://github.com/eProsima/Micro-XRCE-DDS-Agent

if BR2_PACKAGE_MICRO_XRCE_DDS_AGENT

config BR2_PACKAGE_MICRO_XRCE_DDS_AGENT_P2P
	bool "enable P2P discovery profile"
	select BR2_PACKAGE_MICRO_XRCE_DDS_CLIENT
	help
	  Enable peer-to-peer discovery using the CED middleware
	  and Micro-XRCE-DDS-Client.

endif # BR2_PACKAGE_MICRO_XRCE_DDS_AGENT
```

## package/px4-fcu/Config.in
```kconfig
config BR2_PACKAGE_PX4_FCU
	bool "PX4 firmware for the soft FCU"
	help
	  Installs the PX4 (NuttX) firmware of the nexus-v2 board into
	  /lib/firmware, where the fcu_rproc driver picks it up. The
	  firmware is built out of tree, in the px4-core repository
	  (make stalya_nexus-v2_default); this package only takes the
	  resulting ELF.

if BR2_PACKAGE_PX4_FCU

config BR2_PACKAGE_PX4_FCU_ELF
	string "PX4 firmware ELF"
	help
	  Path of the ELF to install, for example
	  <px4-core>/build/stalya_nexus-v2_default/stalya_nexus-v2_default.elf

config BR2_PACKAGE_PX4_FCU_NAME
	string "name under /lib/firmware"
	default "px4_fcu.elf"

endif
```

## package/tinyxml2-v10/Config.in
```kconfig
config BR2_PACKAGE_TINYXML2_V10
	bool "tinyxml2 (10.0.0, for Fast DDS)"
	depends on BR2_INSTALL_LIBSTDCPP
	help
	  TinyXML2 10.0.0. Fast DDS 2.6 does not build against the 11.x API
	  Buildroot ships, so this is the version its packages link against.
	  It installs the same files as the stock tinyxml2 package, so only
	  one of the two may be enabled.

	  https://github.com/leethomason/tinyxml2

comment "tinyxml2 (for Fast DDS) needs a toolchain w/ C++"
	depends on !BR2_INSTALL_LIBSTDCPP
```
